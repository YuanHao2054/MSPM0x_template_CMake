/**
 * @cliArgs --device "MSPM0G350X" --part "Default" --package "LQFP-64(PM)" --product "mspm0_sdk@2.03.00.08"
 * @versions {"tool":"1.21.1+3772"}
 */
scripting.excludeFromBuild("device_linker.cmd");
scripting.excludeFromBuild("device_linker.lds");
scripting.excludeFromBuild("device.opt");
scripting.excludeFromBuild("device.cmd.genlibs");
scripting.excludeFromBuild("device.lds.genlibs");
scripting.excludeFromBuild("Event.dot");

/**
 * Import the modules used in this configuration.
 */
const GPIO  = scripting.addModule("/ti/driverlib/GPIO", {}, false);
const GPIO1 = GPIO.addInstance();
const GPIO2 = GPIO.addInstance();
const GPIO3 = GPIO.addInstance();

/**
 * Write custom configuration values to the imported modules.
 */
GPIO1.$name                              = "LED1";
GPIO1.port                               = "PORTB";
GPIO1.associatedPins[0].$name            = "PIN_22";
GPIO1.associatedPins[0].assignedPin      = "22";
GPIO1.associatedPins[0].internalResistor = "PULL_DOWN";

const Board = scripting.addModule("/ti/driverlib/Board", {}, false);

GPIO2.$name                   = "GPIO_GRP_0";
GPIO2.associatedPins[0].$name = "PIN_0";

GPIO3.$name                   = "GPIO_GRP_1";
GPIO3.associatedPins[0].$name = "PIN_1";

const SYSCTL = scripting.addModule("/ti/driverlib/SYSCTL", {}, false);

const ProjectConfig              = scripting.addModule("/ti/project_config/ProjectConfig", {}, false);
ProjectConfig.migrationCondition = true;

/**
 * Pinmux solution for unlocked pins/peripherals. This ensures that minor changes to the automatic solver in a future
 * version of the tool will not impact the pinmux you originally saw.  These lines can be completely deleted in order to
 * re-solve from scratch.
 */
GPIO1.associatedPins[0].pin.$suggestSolution = "PB22";
Board.peripheral.$suggestSolution            = "DEBUGSS";
Board.peripheral.swclkPin.$suggestSolution   = "PA20";
Board.peripheral.swdioPin.$suggestSolution   = "PA19";
GPIO2.associatedPins[0].pin.$suggestSolution = "PB13";
GPIO3.associatedPins[0].pin.$suggestSolution = "PB14";
SYSCTL.peripheral.$suggestSolution           = "SYSCTL";
